/dts-v1/;
/ {
    compatible = "5bsd,test-board";
    #address-cells = <1>;
    #size-cells = <1>;
    clock: clock {
        compatible = "fixed-clock";
        #clock-cells = <0>;
        clock-frequency = <24000000>;
    };
    device@1000 {
        reg = <0x1000 0x100>;
        clocks = <&clock>;
        status = "okay";
        data = [00 7f 80 ff];
    };
};
