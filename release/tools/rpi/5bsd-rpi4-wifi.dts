/dts-v1/;
/plugin/;

/ {
	compatible = "brcm,bcm2711";
	fragment@0 {
		target-path = "/";
		__overlay__ {
			wifi_pwrseq: wifi-pwrseq {
				compatible = "mmc-pwrseq-simple";
				reset-gpios = <&expgpio 1 1>;
			};
		};
	};
	fragment@1 {
		target = <&mmcnr>;
		__overlay__ {
			status = "okay";
			non-removable;
			mmc-pwrseq = <&wifi_pwrseq>;
		};
	};
	/* disable-bt clears uart0_pins; describe the console route explicitly. */
	fragment@2 {
		target = <&uart0>;
		__overlay__ {
			pinctrl-0 = <&uart0_gpio14>;
		};
	};
};
